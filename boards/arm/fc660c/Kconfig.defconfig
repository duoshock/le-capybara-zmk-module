## boards/arm/fc660c/Kconfig.defconfig
```kconfig
# Le Zapybara board configuration

# Copyright (c) 2020 The ZMK Contributors
# SPDX-License-Identifier: MIT

if BOARD_FC660C

config BOARD
    default "fc660c"

config ZMK_KEYBOARD_NAME
    default "FC660C nrf52"

config ZMK_SLEEP
	select ZMK_ADXL362_AWAKE_TRIGGER_SLEEP
	depends on ZMK_ADXL362_AWAKE_TRIGGER

if ZMK_BATTERY_REPORTING

choice ZMK_BATTERY_REPORTING_FETCH_MODE
	default ZMK_BATTERY_REPORTING_FETCH_MODE_LITHIUM_VOLTAGE
endchoice

endif

if USB

config USB_NRFX
	default y

config USB_DEVICE_STACK
	default y

endif # USB

config BT_CTLR
	default BT

endif # BOARD_LPGALAXY_LE_ZAPYBARA
```
